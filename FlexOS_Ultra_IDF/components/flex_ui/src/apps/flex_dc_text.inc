// GENERADO por tools/gen_devcare_text.py desde FlexOS_Ultra/FlexOS_Ultra_DeviceCare.h (no editar a mano; run_tests.sh lo comprueba).
static const char* DCH[DCS_N][5] = {
  {"Device Care","Device Care","Device Care","Device Care","Device Care"},
  {"Estado del dispositivo","Device status","\xC3\x89tat de l'appareil","Estado do dispositivo","Stato del dispositivo"},
  {"Diagn\xC3\xB3stico completo","Full diagnostics","Diagnostic complet","Diagn\xC3\xB3stico completo","Diagnostica completa"},
  {"Detecci\xC3\xB3n de ca\xC3\xAD" "das","Fall detection","D\xC3\xA9tection de chute","Detec\xC3\xA7\xC3\xA3o de queda","Rilevamento cadute"},
  {"Salud de Flex OS","Flex OS health","Sant\xC3\xA9 de Flex OS","Sa\xC3\xBA" "de do Flex OS","Salute di Flex OS"},
  {"Optimizaci\xC3\xB3n","Optimization","Optimisation","Otimiza\xC3\xA7\xC3\xA3o","Ottimizzazione"},
  {"Historial","History","Historique","Hist\xC3\xB3rico","Cronologia"},
  {"Todo correcto","All good","Tout va bien","Tudo certo","Tutto a posto"},
  {"Necesita atenci\xC3\xB3n","Needs attention","\xC3\x80 surveiller","Precisa aten\xC3\xA7\xC3\xA3o","Richiede attenzione"},
  {"Estado cr\xC3\xADtico","Critical","\xC3\x89tat critique","Estado cr\xC3\xADtico","Stato critico"},
  {"Puntuaci\xC3\xB3n","Score","Score","Pontua\xC3\xA7\xC3\xA3o","Punteggio"},
  {"\xC3\x9Altima revisi\xC3\xB3n","Last check","Dernier contr\xC3\xB4le","\xC3\x9Altima revis\xC3\xA3o","Ultimo controllo"},
  {"Nunca","Never","Jamais","Nunca","Mai"},
  {"Ejecutar","Run","Lancer","Executar","Avvia"},
  {"Repetir","Repeat","Relancer","Repetir","Ripeti"},
  {"Hecho","Done","Termin\xC3\xA9","Conclu\xC3\xAD" "do","Fatto"},
  {"Entendido","Got it","Compris","Entendi","Ho capito"},
  {"Activar","Enable","Activer","Ativar","Attiva"},
  {"Desactivar","Disable","D\xC3\xA9sactiver","Desativar","Disattiva"},
  {"Disponible","Available","Disponible","Dispon\xC3\xADvel","Disponibile"},
  {"No disponible","Unavailable","Indisponible","Indispon\xC3\xADvel","Non disponibile"},
  {"Esta funci\xC3\xB3n requiere un m\xC3\xB3" "dulo IMU compatible.",
   "This feature needs a compatible IMU module.",
   "Cette fonction n\xC3\xA9" "cessite un module IMU compatible.",
   "Este recurso exige um m\xC3\xB3" "dulo IMU compat\xC3\xADvel.",
   "Questa funzione richiede un modulo IMU compatibile."},
  {"M\xC3\xB3" "dulo compatible actualmente:","Currently supported module:","Module compatible actuel :","M\xC3\xB3" "dulo compat\xC3\xADvel atual:","Modulo compatibile attuale:"},
  {"Con\xC3\xA9" "ctalo por I\xC2\xB2""C para usar esta funci\xC3\xB3n.",
   "Connect it over I\xC2\xB2""C to use this feature.",
   "Branche-le en I\xC2\xB2""C pour utiliser cette fonction.",
   "Conecte-o por I\xC2\xB2""C para usar este recurso.",
   "Collegalo via I\xC2\xB2""C per usare questa funzione."},
  {"3V3 \xC2\xB7 GND \xC2\xB7 SCL \xC2\xB7 SDA","3V3 \xC2\xB7 GND \xC2\xB7 SCL \xC2\xB7 SDA","3V3 \xC2\xB7 GND \xC2\xB7 SCL \xC2\xB7 SDA","3V3 \xC2\xB7 GND \xC2\xB7 SCL \xC2\xB7 SDA","3V3 \xC2\xB7 GND \xC2\xB7 SCL \xC2\xB7 SDA"},
  {"M\xC3\xB3" "dulo","Module","Module","M\xC3\xB3" "dulo","Modulo"},
  {"9-DOF IMU","9-DOF IMU","IMU 9 axes","IMU 9-DOF","IMU 9 assi"},
  {"Comunicaci\xC3\xB3n I\xC2\xB2""C","I\xC2\xB2""C link","Liaison I\xC2\xB2""C","Comunica\xC3\xA7\xC3\xA3o I\xC2\xB2""C","Comunicazione I\xC2\xB2""C"},
  {"Aceler\xC3\xB3metro","Accelerometer","Acc\xC3\xA9l\xC3\xA9rom\xC3\xA8tre","Aceler\xC3\xB4metro","Accelerometro"},
  {"Giroscopio","Gyroscope","Gyroscope","Girosc\xC3\xB3pio","Giroscopio"},
  {"Magnet\xC3\xB3metro","Magnetometer","Magn\xC3\xA9tom\xC3\xA8tre","Magnet\xC3\xB4metro","Magnetometro"},
  {"Sensor Fusion","Sensor fusion","Fusion de capteurs","Fus\xC3\xA3o de sensores","Fusione sensori"},
  {"Monitorizando","Monitoring","Surveillance","Monitorando","Monitoraggio"},
  {"Sin monitorizar","Not monitoring","Sans surveillance","Sem monitoramento","Nessun monitoraggio"},
  {"Probar m\xC3\xB3" "dulo","Test module","Tester le module","Testar m\xC3\xB3" "dulo","Prova modulo"},
  {"Confianza","Confidence","Confiance","Confian\xC3\xA7" "a","Attendibilit\xC3\xA0"},
  {"Sin eventos","No events","Aucun \xC3\xA9v\xC3\xA9nement","Sem eventos","Nessun evento"},
  {"Todav\xC3\xAD" "a no hay nada registrado.","Nothing recorded yet.","Rien d'enregistr\xC3\xA9 pour l'instant.","Ainda n\xC3\xA3o h\xC3\xA1 registros.","Ancora nessuna registrazione."},
  {"Memoria","Memory","M\xC3\xA9moire","Mem\xC3\xB3ria","Memoria"},
  {"PSRAM","PSRAM","PSRAM","PSRAM","PSRAM"},
  {"Estabilidad","Stability","Stabilit\xC3\xA9","Estabilidade","Stabilit\xC3\xA0"},
  {"Watchdog","Watchdog","Watchdog","Watchdog","Watchdog"},
  {"Servicios","Services","Services","Servi\xC3\xA7os","Servizi"},
  {"Errores","Errors","Erreurs","Erros","Errori"},
  {"Reinicios","Reboots","Red\xC3\xA9marrages","Reinicializa\xC3\xA7\xC3\xB5" "es","Riavvii"},
  {"Almacenamiento","Storage","Stockage","Armazenamento","Archivi"},
  {"No disponible","Not available","Non disponible","N\xC3\xA3o dispon\xC3\xADvel","Non disponibile"},
  {"Solo acciones seguras","Safe actions only","Actions s\xC3\xBBres uniquement","Apenas a\xC3\xA7\xC3\xB5" "es seguras","Solo azioni sicure"},
  {"No se borran notas, dibujos ni archivos.","Notes, drawings and files are never deleted.","Ni notes, ni dessins, ni fichiers ne sont effac\xC3\xA9s.","Notas, desenhos e arquivos n\xC3\xA3o se apagam.","Note, disegni e file non si cancellano."},
  {"Optimizar Flex OS","Optimize Flex OS","Optimiser Flex OS","Otimizar Flex OS","Ottimizza Flex OS"},
  {"Diagn\xC3\xB3stico","Diagnostics","Diagnostic","Diagn\xC3\xB3stico","Diagnostica"},
  {"Posible ca\xC3\xAD" "da","Possible fall","Chute possible","Poss\xC3\xADvel queda","Possibile caduta"},
  {"Revisi\xC3\xB3n tras impacto","Post-impact check","Contr\xC3\xB4le apr\xC3\xA8s impact","Revis\xC3\xA3o ap\xC3\xB3s impacto","Controllo post-impatto"},
  {"Optimizaci\xC3\xB3n","Optimization","Optimisation","Otimiza\xC3\xA7\xC3\xA3o","Ottimizzazione"},
  {"Impacto","Impact","Impact","Impacto","Impatto"},
  {"Diagn\xC3\xB3stico posterior","Follow-up check","Contr\xC3\xB4le ult\xC3\xA9rieur","Diagn\xC3\xB3stico posterior","Controllo successivo"},
  {"Normal","Normal","Normal","Normal","Normale"},
  {"Detecci\xC3\xB3n experimental de eventos f\xC3\xADsicos.","Experimental physical-event detection.","D\xC3\xA9tection exp\xC3\xA9rimentale d'\xC3\xA9v\xC3\xA9nements physiques.","Detec\xC3\xA7\xC3\xA3o experimental de eventos f\xC3\xADsicos.","Rilevamento sperimentale di eventi fisici."},
  {"Tiempo encendido","Uptime","Temps allum\xC3\xA9","Tempo ligado","Tempo acceso"},
  {"Ritmo del sistema","System rate","Rythme du syst\xC3\xA8me","Ritmo do sistema","Ritmo del sistema"},
  {"Detectando m\xC3\xB3" "dulo\xE2\x80\xA6","Detecting module\xE2\x80\xA6","D\xC3\xA9tection du module\xE2\x80\xA6","Detectando m\xC3\xB3" "dulo\xE2\x80\xA6","Rilevamento modulo\xE2\x80\xA6"},
  {"S\xC3\xAD","Yes","Oui","Sim","S\xC3\xAC"},
  {"No","No","Non","N\xC3\xA3o","No"},
  {"\xC2\xBFLa pantalla reproduce correctamente",
   "Does the screen show colors and",
   "L'\xC3\xA9" "cran affiche-t-il correctement",
   "A tela reproduz corretamente",
   "Lo schermo riproduce correttamente"},
  {"los colores y patrones?","patterns correctly?","les couleurs et les motifs ?","as cores e os padr\xC3\xB5" "es?","i colori e i motivi?"},
  {"Recorre toda la rejilla con el dedo","Sweep the whole grid with your finger","Parcours toute la grille au doigt","Percorra toda a grade com o dedo","Percorri tutta la griglia con il dito"},
  {"Sistema","System","Syst\xC3\xA8me","Sistema","Sistema"},
  {"Pantalla","Screen","\xC3\x89" "cran","Tela","Schermo"},
  {"T\xC3\xA1" "ctil","Touch","Tactile","Toque","Tocco"},
  {"POSIBLE CA\xC3\x8D" "DA DETECTADA","POSSIBLE FALL DETECTED","CHUTE POSSIBLE D\xC3\x89TECT\xC3\x89" "E","POSS\xC3\x8DVEL QUEDA DETECTADA","POSSIBILE CADUTA RILEVATA"},
  {"Se detect\xC3\xB3 un impacto que podr\xC3\xAD" "a corresponder a una ca\xC3\xAD" "da.",
   "An impact was detected that could correspond to a fall.",
   "Un impact pouvant correspondre \xC3\xA0 une chute a \xC3\xA9t\xC3\xA9 d\xC3\xA9tect\xC3\xA9.",
   "Foi detectado um impacto que pode corresponder a uma queda.",
   "\xC3\x88 stato rilevato un impatto che potrebbe essere una caduta."},
  {"Revisar dispositivo","Check device","V\xC3\xA9rifier l'appareil","Revisar dispositivo","Controlla il dispositivo"},
  {"Descartar","Dismiss","Ignorer","Descartar","Ignora"},
  {"Analizar la memoria y medirla de nuevo","Analyze memory and measure it again","Analyser la m\xC3\xA9moire et la remesurer","Analisar a mem\xC3\xB3ria e medi-la de novo","Analizzare la memoria e rimisurarla"},
  {"Vaciar la cach\xC3\xA9 temporal del sistema","Clear the system temporary cache","Vider le cache temporaire du syst\xC3\xA8me","Esvaziar o cache tempor\xC3\xA1rio do sistema","Svuotare la cache temporanea di sistema"},
  {"Soltar recursos reconstruibles de apps en pausa","Release rebuildable resources of paused apps","Lib\xC3\xA9rer les ressources reconstructibles des apps en pause","Liberar recursos reconstru\xC3\xADveis de apps em pausa","Rilasciare risorse ricostruibili delle app in pausa"},
  {"Verificar la estabilidad tras liberar","Verify stability after releasing","V\xC3\xA9rifier la stabilit\xC3\xA9 apr\xC3\xA8s lib\xC3\xA9ration","Verificar a estabilidade ap\xC3\xB3s liberar","Verificare la stabilit\xC3\xA0 dopo il rilascio"},
  {"No se toca la actualizaci\xC3\xB3n del sistema ni el firmware.",
   "System updates and firmware are never touched.",
   "Ni la mise \xC3\xA0 jour du syst\xC3\xA8me ni le micrologiciel ne sont touch\xC3\xA9s.",
   "A atualiza\xC3\xA7\xC3\xA3o do sistema e o firmware n\xC3\xA3o se tocam.",
   "L'aggiornamento di sistema e il firmware non si toccano."},
};
